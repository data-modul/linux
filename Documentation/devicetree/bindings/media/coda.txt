## Documentation/devicetree/bindings/media/coda.txt
```
Chips&Media Coda multi-standard codec IP
========================================

Coda codec IPs are present in i.MX SoCs in various versions,
called VPU (Video Processing Unit).

Required properties:
- compatible : should be "fsl,<chip>-src", "cnm,coda<model>" for i.MX SoCs:
  (a) "fsl,imx27-vpu", "cnm,codadx6" for CodaDx6 present in i.MX27
  (b) "fsl,imx53-vpu", "cnm,coda7541" for CODA7541 present in i.MX53
  (c) "fsl,imx6q-vpu", "cnm,coda960" for CODA960 present in i.MX6Q/D
  (d) "fsl,imx6dl-vpu", "cnm,coda960" for CODA960 present in i.MX6DL/S
- reg: should be register base and length as documented in the
  SoC reference manual
- interrupts : Should contain the VPU interrupt. For CODA960,
  a second interrupt is needed for the MJPEG unit.
- clocks : Should contain the ahb and per clocks, in the order
  determined by the clock-names property.
- clock-names : Should be "ahb", "per"
- iram : phandle pointing to the SRAM device node

Example:

vpu: vpu@63ff4000 {
	compatible = "fsl,imx53-vpu", "cnm,coda7541";
	reg = <0x63ff4000 0x1000>;
	interrupts = <9>;
	clocks = <&clks 63>, <&clks 63>;
	clock-names = "ahb", "per";
	iram = <&ocram>;
};
```

## drivers/media/platform/imx/Kconfig
```kconfig
config MEDIA_IMX
	tristate "Multimedia Support for Freescale i.MX"
	help
	  This driver provides a SoC wide media controller device that all
	  multimedia components in i.MX5 and i.MX6 SoCs can register with.

config MEDIA_IMX_IPU
	tristate "i.MX Image Processing Unit (v3) core driver"
	help
	  This driver provides core support for the i.MX IPUv3 contained in
	  i.MX5 and i.MX6 SoCs.

config MEDIA_IMX_VIDEO_SWITCH
	tristate "i.MX Video Bus Multiplexer"
	depends on VIDEO_V4L2_SUBDEV_API
	help
	  This driver provides support for SoC internal video bus multiplexers
	  controlled by register bitfields as well as external multiplexers
	  controller by a GPIO.
```
